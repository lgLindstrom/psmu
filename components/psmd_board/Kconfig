## components/psmd_board/Kconfig
```kconfig
menu "PSMD"

    choice PSMD_BOARD
        prompt "Board variant"
        default PSMD_BOARD_DEV
        help
            The board the firmware is built for. The development board is the
            ESP32-C6 bring-up board; the production board's pin map is open
            (GAP-02).

        config PSMD_BOARD_DEV
            bool "Development board (ESP32-C6, button and both LEDs)"
        config PSMD_BOARD_PRODUCTION
            bool "Production board (pin map open, does not build yet)"
    endchoice

    choice PSMD_MU_BACKEND
        prompt "MU backend"
        default PSMD_MU_SIM if PSMD_BOARD_DEV
        default PSMD_MU_I2C
        help
            The Measurement Unit backend. The development board uses the
            simulated MU until the real interface exists (TBD-28).

        config PSMD_MU_SIM
            bool "Simulated MU (no I2C)"
        config PSMD_MU_I2C
            bool "MU over I2C (TBD-28, does not build yet)"
    endchoice

endmenu
```

## main/Kconfig.projbuild
```kconfig
menu "PSMD"

    config PSMD_OUTPUT_GPIO
        int "GPIO connected to the simulated Output"
        range 0 30
        default 2
        help
            GPIO that stands in for the relay until the real Power Unit exists.
            The final pin map is owned by GAP-02.

endmenu
```
